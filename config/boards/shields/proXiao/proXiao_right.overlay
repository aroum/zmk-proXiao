/*
 * Copyright (c) 2020 The ZMK Contributors
 *
 * SPDX-License-Identifier: MIT
 */

#include "proXiao.dtsi"

&default_transform {
	col-offset = <6>;
};

&kscan0 {
	col-gpios
		= <&xiao_d 7 GPIO_ACTIVE_HIGH>
		, <&xiao_d 0 GPIO_ACTIVE_HIGH>
		, <&xiao_d 1 GPIO_ACTIVE_HIGH>
		, <&xiao_d 2 GPIO_ACTIVE_HIGH>
		, <&xiao_d 3 GPIO_ACTIVE_HIGH>
		, <&xiao_d 6 GPIO_ACTIVE_HIGH>
		;
};

&right_encoder {
	status = "okay";
};
