/*
 * Copyright (c) 2020 The ZMK Contributors
 *
 * SPDX-License-Identifier: MIT
 */

#include "proXiao.dtsi"

&kscan0 {
	col-gpios
		= <&xiao_d 6 GPIO_ACTIVE_HIGH>
		, <&xiao_d 3 GPIO_ACTIVE_HIGH>
		, <&xiao_d 2 GPIO_ACTIVE_HIGH>
		, <&xiao_d 1 GPIO_ACTIVE_HIGH>
		, <&xiao_d 0 GPIO_ACTIVE_HIGH>
		, <&xiao_d 7 GPIO_ACTIVE_HIGH>
		;
};

&left_encoder {
	status = "okay";
};
