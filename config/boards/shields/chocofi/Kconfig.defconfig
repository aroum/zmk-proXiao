## config/boards/shields/chocofi/Kconfig.defconfig
```kconfig
if SHIELD_CHOCOFI_RIGHT

config ZMK_KEYBOARD_NAME
	default "Corne"

config ZMK_SPLIT_ROLE_CENTRAL
	default y

endif

if SHIELD_CHOCOFI_LEFT || SHIELD_CHOCOFI_RIGHT

config ZMK_SPLIT
	default y

endif
```

## config/boards/shields/proXiao/Kconfig.defconfig
```kconfig
# Copyright (c) 2020 The ZMK Contributors
# SPDX-License-Identifier: MIT

if SHIELD_PROXIAO

config ZMK_KEYBOARD_NAME
	default "Reviung41"

endif
```

## config/boards/shields/proXiao/Kconfig.shield
```kconfig
# Copyright (c) 2020 The ZMK Contributors
# SPDX-License-Identifier: MIT

config SHIELD_PROXIAO
	def_bool $(shields_list_contains, proXiao)
```
